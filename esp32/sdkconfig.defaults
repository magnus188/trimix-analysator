## esp32/sdkconfig.defaults
```kconfig
# General ESP32 Configuration
CONFIG_ESP_TASK_WDT_TIMEOUT_S=10

# Memory configuration for LVGL
CONFIG_SPIRAM=y
CONFIG_SPIRAM_USE_MALLOC=y

# LCD Configuration
CONFIG_LCD_RGB_ISR_IRAM_SAFE=y

# I2C Configuration
CONFIG_I2C_ENABLE_DEBUG_LOG=y

# FreeRTOS Configuration
CONFIG_FREERTOS_HZ=1000
CONFIG_FREERTOS_USE_TRACE_FACILITY=y
CONFIG_FREERTOS_USE_STATS_FORMATTING_FUNCTIONS=y

# Component configuration
CONFIG_LWIP_SO_REUSE=y

# Log Configuration
CONFIG_LOG_DEFAULT_LEVEL_INFO=y
```

## esp32/sdkconfig.defaults.esp32s3
```kconfig
# ESP32-S3 Configuration
CONFIG_IDF_TARGET="esp32s3"

# Memory configuration
CONFIG_SPIRAM=y
CONFIG_SPIRAM_MODE_OCT=y
CONFIG_SPIRAM_SPEED_80M=y

# PSRAM
CONFIG_ESP32S3_SPIRAM_SUPPORT=y
CONFIG_SPIRAM_USE_MALLOC=y
CONFIG_SPIRAM_MALLOC_ALWAYSINTERNAL=16384

# LCD and display
CONFIG_LCD_RGB_ISR_IRAM_SAFE=y
CONFIG_LCD_RGB_RESTART_IN_VSYNC=y

# I2C Configuration
CONFIG_I2C_ENABLE_DEBUG_LOG=y

# ADC Configuration  
CONFIG_ADC_ONESHOT_CTRL_FUNC_IN_IRAM=y
CONFIG_ADC_CAL_EFUSE_TP_ENABLE=y
CONFIG_ADC_CAL_EFUSE_VREF_ENABLE=y
CONFIG_ADC_CALI_EFUSE_SCHEME=y

# FreeRTOS
CONFIG_FREERTOS_HZ=1000

# Log levels
CONFIG_LOG_DEFAULT_LEVEL_INFO=y
CONFIG_LOG_MAXIMUM_LEVEL_VERBOSE=y
```

## sdkconfig.defaults
```kconfig
CONFIG_IDF_TARGET="esp32s3"
CONFIG_IDF_TARGET_ESP32S3=y
# Custom partition table with 4MB app + 4MB OTA
CONFIG_PARTITION_TABLE_CUSTOM=y
CONFIG_PARTITION_TABLE_CUSTOM_FILENAME="partitions.csv"

# Enable ccache for faster rebuilds
CONFIG_COMPILER_CCACHE=y

# Release-oriented firmware defaults
CONFIG_COMPILER_OPTIMIZATION_SIZE=y
CONFIG_COMPILER_OPTIMIZATION_ASSERTIONS_ENABLE=y
CONFIG_BOOTLOADER_COMPILER_OPTIMIZATION_SIZE=y
CONFIG_LOG_DEFAULT_LEVEL_WARN=y
```
